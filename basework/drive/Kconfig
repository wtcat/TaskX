## basework/drive/Kconfig
```kconfig
choice
	prompt "PPG sensor"
	default PPG_HX3690
	help
	  Select PPG device driver

config PPG_HX3690
    bool "PPG-HX3690 device driver"
	
config PPG_HX3918
    bool "PPG-HX3918 device driver"
config PPG_PAH8311
    bool "PPG-PAH8311 device driver"
config PPG_HX3695L
    bool "PPG-HX3695L device driver"
endchoice

config UART_GPS
    bool "GPS uart driver"
    default n

config MXS_ENCODER
    bool "Input encoder driver"
    default y

config VIBRATION_MOTOR
    bool "vibration motor driver"
    default y

config WTM2101AC
    bool "WTM2101AC AI-CHIP"
    default n

config WTM_OTA_SERVICE
    bool "Enable WTM2101 update service"
    depends on WTM2101AC
    default y
	
config MIC_INPUT
    bool "WTM2101AC AI-MIC"
    default n


config 4G_MODEM
    bool "4G modem with uart"
    default n

config GSENSOR_LIS2DH12
    bool "Gsensor lis2dh12"
    default n

if GSENSOR_LIS2DH12
    config GSENSOR_LIS2DH12_SPI
        bool
        default y if BOARD_ATS3085L_CW02_EXT_NOR
        default n
endif

config GENSOR_LSM6DSO
    bool "Gsensor lsm6dso"
    default n
	
config MAGNETIC_QMC6308
    bool "magnetic qmc6308"
    default n
	
config MAGNETIC_MMC5603
    bool "magnetic mmc5603"
    default n

config BAROCEPTOR
    bool "baroceptor sensor"
    default n
```

## basework/ui/Kconfig
```kconfig
menuconfig BASEWORK_UI
    bool "Basework UI compoment"
    default n

if BASEWORK_UI

config LVGL_ENCODER
    bool "Enable encoder intput device for lvgl"
    default n


endif #BASEWORK_UI
```
